#ifndef TIMER_C
#define TIMER_C
#include "includes\headfile.h"
#ifdef  HAVE_TIME0_EN
/*****************************************************************************
函数名：Timer0_init
功能描述：Timer0初始化
输入参数：无
返回值： 无
******************************************************************************/
void Timer0_init(void)     //定时器初始化
{
	TMOD = (TMOD&0xF0)|0x01; 	//模式选择: 定时器0，模式1。
	TH0 = TH0_VAL;    					//高8位装初值
	TL0 = TL0_VAL;    					//低8位装初值
	
	TR0 = 1;       //定时器0使能  
	ET0 = 1;       //定时器0中断使能
	PT0 = 0;       //设置定时器0中断优先级为低优先级	
}
/*****************************************************************************
函数名：TIMER0_ISR
功能描述：Timer0中断处理
输入参数：无
返回值： 无
******************************************************************************/
void TIMER0_ISR (void) interrupt 1 		 //每1ms产生中断
{
	TH0 = TH0_VAL;
	TL0 = TL0_VAL;
	Timer0_isr_proc();	
}
#endif
#ifdef  HAVE_TIME1_EN
/*****************************************************************************
函数名：Timer1_init
功能描述：Timer1初始化
输入参数：无
返回值： 无
******************************************************************************/
void Timer1_init(void)     //定时器初始化
{
	TMOD = (TMOD&0x0F)|0x10; 	//模式选择: 定时器0，模式1。
	TH1 = TH1_VAL;    					//高8位装初值
	TL1 = TL1_VAL;    					//低8位装初值
	
	TR1 = 1;       //定时器1使能  
	ET1 = 1;       //定时器1中断使能
	PT1 = 0;       //设置定时器1中断优先级为低优先级	
}
/*****************************************************************************
函数名：TIMER1_ISR
功能描述：Timer1中断处理
输入参数：无
返回值： 无
******************************************************************************/
void TIMER1_ISR (void) interrupt 3 		 //每1ms产生中断
{
	TH1 = TH1_VAL;
	TL1 = TL1_VAL;
	Timer1_isr_proc();	
}
#endif
#ifdef  HAVE_TIME2_EN
/*****************************************************************************
函数名：Timer2_init
功能描述：Timer2初始化
输入参数：无
返回值： 无
******************************************************************************/
void Timer2_init(void)
{
	T2CON = TR2(0) | IE2(1) | TF2 | OF2 | CF2 | CPEDGESEL(0) | T2M(0);			//设置定时器为重载模式0																	                                                     

	T2CRH = TH2_VAL;									//设置T2重载值
	T2CRL = TL2_VAL;
	T2CON |= TR2(1);   							//定时器2使能
	INT3EN = 1;//定时器2中断使能	
}
/*****************************************************************************
函数名：TIMER2_ISR
功能描述：Timer2中断处理
输入参数：无
返回值： 无
******************************************************************************/
void Timer2_isr(void)
{
	if(T2CON & TF2)	  //定时器2溢出中断
	{
		T2CON |= TF2;
		Timer2_isr_proc();
	}
  if(T2CON & OF2)
	{
		T2CON |= OF2;	

	}
	if(T2CON & CF2)
	{
		T2CON |= CF2;
		
	}
}
#endif
#ifdef HAVE_TMC_TIME_EN
/*****************************************************************************
函数名：TMC_timer_init
功能描述：TMC 定时器初始化
输入参数：无
				TMC 中断时间配置寄存器
				当 TMC 定时器的时钟源为 IRCL 时，TMC 的中断时间为（TMSNU+1）x512×Tircl；
				当 TMC 定时器的时钟源为 XOSCL 时，TMC 的中断时间为（TMSNU+1）x128×Txoscl
				注：Tircl 为 IRCL 时钟一个周期时间() :1/(IRCL_fosc*1000)   0.0039s~0.997s
            Txoscl为 XOSCL 时钟一个周期时间()
返回值： 无
******************************************************************************/
void TMC_timer_init(void)    //约4ms 定时
{
	    #if  (TMC_CLK_SRC)
			P22_CFG_XOSCL_OUT;
			P23_CFG_XOSCL_IN;	       //XOSCL 起振时间比较长，大约需要 1 秒左右才能达到稳定
			CKCON |= XLCKE;					//使能XOSCL时钟	
			CKCON |= TMCS(1);				//TMC计数时钟XOSCL时钟, 	 //设置 1 个最小单位时间（即 128 个 IRCL 时钟周期）产生中断
	    #else
	    CKCON |= ILCKE; 				//打开 IRCL 时钟
	    CKCON |= TMCS(0);				//TMC计数时钟IRCL时钟, 	
			#endif
			TMCON = TME(1); //TMC 使能
			TMSNU = TMSNU_VALUE; 			      //设置 1 个最小单位时间（即 512 个 IRCL 时钟周期）产生中断
			INT3EN = 1; 		//开启 TMC 中断
}
#endif
#endif